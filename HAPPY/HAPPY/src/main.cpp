#include <Arduino.h>
#include <Wire.h>
#include <SPI.h>

//行列引脚 row col
int rows[8] = {2,7,A5,5,13,A4,12,A2};
int cols[8] = {6,11,10,3,A3,4,8,9};
//5 4 3 2 1 
unsigned char FIVE[8][8]={
  {0,0,1,1,1,1,0,0},
  {0,0,1,0,0,0,0,0},
  {0,0,1,0,0,0,0,0},
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  {0,0,1,1,1,1,0,0},

};
unsigned char FOUR[8][8]={
  {0,0,0,0,0,0,0,0},
  {0,0,0,0,1,1,0,0},
  {0,0,0,1,1,1,0,0},
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  {0,0,0,0,0,1,0,0},

};
unsigned char THREE[8][8]={
  {0,0,0,0,0,0,0,0},
  {0,0,1,1,1,1,0,0},
  {0,1,1,0,0,1,1,0},
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  {0,0,1,1,1,1,0,0},

};
unsigned char TWO[8][8]={
  {0,0,0,0,0,0,0,0},
  {0,0,1,1,1,1,0,0},
  {0,1,1,0,0,1,1,0},
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  {0,1,1,1,1,1,1,0},

};
unsigned char ONE[8][8]={
  {0,0,0,0,0,0,0,0},
  {0,0,0,1,1,0,0,0},
  {0,0,0,1,1,0,0,0},
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  {0,1,1,1,1,1,1,0},

};

//显示爱心
unsigned char LOVE_BIG[8][8]={
  {0,1,1,0,0,1,1,0},
  {1,0,0,1,1,0,0,1},
  {1,0,0,0,0,0,0,1},
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  {0,0,0,1,1,0,0,0},

};
unsigned char LOVE_SMALL[8][8]={
  {0,0,0,0,0,0,0,0},
  {0,0,1,0,0,1,0,0},
  {0,1,0,1,1,0,1,0},    
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  {0,0,0,0,0,0,0,0},

};
//清除屏幕
void clear(){
  for(int i = 0 ; i<8 ; i++){
    digitalWrite(rows[i],LOW);
    digitalWrite(cols[i],HIGH);
  }
}
//显示函数
void Display(unsigned char dat[8][8]){
  for(int c = 0 ; c<8 ; c++){
    digitalWrite(cols[c],LOW);
    for(int r = 0 ; r<8 ; r++){
    digitalWrite(rows[r],dat[r][c]);
  }
  
  }
   delay(800);
   clear();
}

//开始
void setup() {
  for(int i=0;i<8;i++){
    pinMode(rows[i],OUTPUT) ;
    pinMode(cols[i],OUTPUT) ;
  }
  //显示5 4 3 2 1
  Display(FIVE);
  delay(1000);
  clear();
   Display(FOUR);
  delay(1000);
  clear();
   Display(THREE);
  delay(1000);
  clear();
   Display(TWO);
  delay(1000);
  clear();
   Display(ONE);
  delay(1000);
  clear();
  }
  
  void loop(){
    for(int i=0;i<100;i++){
      Display(LOVE_BIG);
      delay(1000);
    }
    for(int i=0;i<50;i++){
      Display(LOVE_SMALL);
      delay(1000);
    }
  }
